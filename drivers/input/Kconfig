## drivers/input/Kconfig
```kconfig
# Copyright (c) 2021 Nordic Semiconductor ASA
# SPDX-License-Identifier: Apache-2.0

if INPUT
rsource "mt6701/Kconfig"
endif # INPUT
```

## drivers/input/mt6701/Kconfig
```kconfig
# Copyright (c) 2021 Nordic Semiconductor ASA
# SPDX-License-Identifier: Apache-2.0

config MT6701
	bool "MT6701 magnetic encoder"
	default y
  depends on GPIO
  depends on SPI
  depends on INPUT
	help
    MT6701 magnetic encoder
```

## dts/bindings/input/magntek,mt6701.yaml
```yaml
description: |
  Magnetic encoder driver for the MagnTek MT6701

compatible: "magntek,mt6701"

include: ["spi-device.yaml"]
```
